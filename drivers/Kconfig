## drivers/rfid/rc522/Kconfig
```kconfig
# NXP MFRC522 RFID reader driver
# Copyright (c) 2025
# SPDX-License-Identifier: Apache-2.0

menuconfig RC522
	bool "NXP MFRC522 RFID reader driver"
	default y
	depends on DT_HAS_NXP_RC522_ENABLED
	select SPI
	help
	  Enable driver for the NXP MFRC522 RFID/NFC reader chip.
	  Uses SPI to communicate with the chip and exposes a simple
	  API for card detection and UID reading.

if RC522

config RC522_LOG_LEVEL
	int "RC522 driver log level"
	default 3
	range 0 4
	help
	  Log level for the RC522 driver (0=off, 1=ERR, 2=WRN, 3=INF, 4=DBG).

endif # RC522
```

## drivers/sensors/st/ism330dlc/Kconfig
```kconfig
# ST Microelectronics ISM330DLC 6-axis IMU sensor driver

# Copyright (c) 2020 STMicroelectronics
# SPDX-License-Identifier: Apache-2.0

menuconfig ISM330DLC
	bool "ISM330DLC I2C/SPI accelerometer and gyroscope Chip"
	default y
	depends on DT_HAS_ST_ISM330DLC_ENABLED
	select I2C if $(dt_compat_on_bus,$(DT_COMPAT_ST_ISM330DLC),i2c)
	help
	  Enable driver for ISM330DLC accelerometer and gyroscope
	  sensor.
```

## drivers/sensors/st/vl53l5cx/Kconfig
```kconfig
# ST Microelectronics VL53L5CX multi-zone ToF sensor driver
#
# Copyright (c) 2025 STMicroelectronics
# SPDX-License-Identifier: Apache-2.0

menuconfig VL53L5CX
	bool "VL53L5CX multi-zone Time-of-Flight ranging sensor"
	default y
	depends on DT_HAS_ST_VL53L5CX_ENABLED
	select I2C if $(dt_compat_on_bus,$(DT_COMPAT_ST_VL53L5CX),i2c)
	help
	  Enable driver for the VL53L5CX 4x4 / 8x8 zone ToF ranging sensor.
```

## dts/bindings/rfid/nxp,rc522.yaml
```yaml
# Copyright (c) 2025
# SPDX-License-Identifier: Apache-2.0

description: NXP MFRC522 RFID/NFC Reader

compatible: "nxp,rc522"

include: spi-device.yaml
```

## dts/bindings/sensors/st,ism330dlc.yaml
```yaml
# Copyright (c) 2025 STMicroelectronics
# SPDX-License-Identifier: Apache-2.0

description: |
  STMicroelectronics ISM330DLC 6-axis IMU (3-axis accelerometer + 3-axis
  gyroscope) on I2C bus.

  Example overlay usage:

    &i2c1 {
        ism330dlc: ism330dlc@6a {
            compatible = "st,ism330dlc";
            reg = <0x6a>;

            accel-odr   = <104>;
            accel-range = <2>;
            gyro-odr    = <104>;
            gyro-range  = <2000>;
        };
    };

  I2C address is 0x6a (SA0=GND) or 0x6b (SA0=VCC).

compatible: "st,ism330dlc"

include: i2c-device.yaml

properties:
  accel-odr:
    type: int
    default: 104
    description: |
      Accelerometer output data rate in Hz.
      Valid values: 12, 26, 52, 104, 208, 416, 833, 1660, 3330, 6660.

  accel-range:
    type: int
    default: 2
    description: |
      Accelerometer full-scale range in g.
      Valid values: 2, 4, 8, 16.

  gyro-odr:
    type: int
    default: 104
    description: |
      Gyroscope output data rate in Hz.
      Valid values: 12, 26, 52, 104, 208, 416, 833, 1660, 3330, 6660.

  gyro-range:
    type: int
    default: 2000
    description: |
      Gyroscope full-scale range in dps.
      Valid values: 125, 250, 500, 1000, 2000.
```

## dts/bindings/sensors/st,vl53l5cx.yaml
```yaml
# Copyright (c) 2025 STMicroelectronics
# SPDX-License-Identifier: Apache-2.0

description: |
  STMicroelectronics VL53L5CX multi-zone Time-of-Flight ranging sensor
  on I2C bus (4×4 or 8×8 zone grid, distance in mm).

  Example overlay usage:

    &i2c1 {
        vl53l5cx: vl53l5cx@29 {
            compatible = "st,vl53l5cx";
            reg = <0x29>;          /* default 7-bit address; can be changed */

            ranging-profile = <1>; /* 1=4x4 continuous, 3=8x8 continuous   */
            timing-budget   = <30>;
            frequency       = <5>;
        };
    };

compatible: "st,vl53l5cx"

include: i2c-device.yaml

properties:
  ranging-profile:
    type: int
    default: 1
    description: |
      Ranging profile selection:
        1 = VL53L5CX_PROFILE_4x4_CONTINUOUS
        2 = VL53L5CX_PROFILE_4x4_AUTONOMOUS
        3 = VL53L5CX_PROFILE_8x8_CONTINUOUS
        4 = VL53L5CX_PROFILE_8x8_AUTONOMOUS

  timing-budget:
    type: int
    default: 30
    description: |
      Per-measurement timing budget in milliseconds.
      Valid range: 2–1000 ms (sensor-dependent).

  frequency:
    type: int
    default: 5
    description: |
      Target ranging frequency in Hz.
      Valid range: 1–60 Hz (sensor-dependent).
```

## west.yml
```yaml
# Copyright (c) 2025 STMicroelectronics
# SPDX-License-Identifier: Apache-2.0

manifest:
  version: 1.0

  self:
    path: zephyr-samples-imu

  projects:
    - name: zephyr
      url: https://github.com/zephyrproject-rtos/zephyr.git
      revision: v4.3.0
      west-commands: scripts/west-commands.yml
      import:
        name-allowlist:
          - cmsis_6
          - cmsis-dsp
          - hal_stm32
          - mcuboot
          - mbedtls
```
